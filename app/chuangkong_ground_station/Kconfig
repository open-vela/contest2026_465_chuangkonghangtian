## app/chuangkong_ground_station/Kconfig
```kconfig
config EXAMPLES_UART2HWTEST
	bool "UART2 hardware test"
	default n
	---help---
		Direct UART2 hardware test bypassing NuttX serial driver.

if EXAMPLES_UART2HWTEST

config EXAMPLES_UART2HWTEST_PRIORITY
	int "UART2 hw test priority"
	default 100

config EXAMPLES_UART2HWTEST_STACKSIZE
	int "UART2 hw test stack size"
	default 2048

endif
```

## tools/touch_demo/Kconfig
```kconfig
config EXAMPLES_TOUCH_DEMO
	bool "Touch screen demo"
	default n
	---help---
		Reads /dev/input0 and prints touch coordinates.

if EXAMPLES_TOUCH_DEMO

config EXAMPLES_TOUCH_DEMO_PRIORITY
	int "Touch demo priority"
	default 100

config EXAMPLES_TOUCH_DEMO_STACKSIZE
	int "Touch demo stack size"
	default 4096

endif
```
